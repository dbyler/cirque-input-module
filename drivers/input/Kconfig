## drivers/input/Kconfig
```kconfig
# Copyright (c) 2022 The ZMK Contributors
# SPDX-License-Identifier: MIT

config ZMK_INPUT_PINNACLE
    bool "Cirque Pinnacle trackpad driver"
    default y
    depends on DT_HAS_ZMK_CIRQUE_PINNACLE_ENABLED

if ZMK_INPUT_PINNACLE

config INPUT_PINNACLE_INIT_PRIORITY
    int "Cirque Pinnacle initialization priority"
    default INPUT_INIT_PRIORITY

if ZMK_MOUSE

config ZMK_INPUT_PINNACLE_IDLE_SLEEPER
    bool "Pinnacle Sleep linked to ZMK idle state"
    default n

endif

endif
```

## dts/bindings/input/cirque,pinnacle-i2c.yaml
```yaml
description: |
  Sensor driver for the Cirque Pinnacle trackpad ASICs, using the I2C interface

compatible: "zmk,cirque-pinnacle"

include: ["i2c-device.yaml", "zmk,cirque-pinnacle-common.yaml"]
```

## dts/bindings/input/cirque,pinnacle-spi.yaml
```yaml
description: |
  Sensor driver for the Cirque Pinnacle trackpad ASICs, using the SPI interface

compatible: "zmk,cirque-pinnacle"

include: ["spi-device.yaml", "zmk,cirque-pinnacle-common.yaml"]
```
